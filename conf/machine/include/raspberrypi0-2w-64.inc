## conf/machine/include/raspberrypi0-2w-64.inc
```bitbake
require raspberrypi-common.inc

KERNEL_DEVICETREE:raspberrypi0-2w-64:sota ?= " broadcom/bcm2710-rpi-zero-2.dtb overlays/vc4-fkms-v3d.dtbo overlays/rpi-ft5406.dtbo"
```

## conf/machine/include/raspberrypi0-wifi.inc
```bitbake
require raspberrypi-common.inc

KERNEL_DEVICETREE:raspberrypi0-wifi:sota ?= " bcm2708-rpi-zero-w.dtb overlays/vc4-fkms-v3d.dtbo overlays/rpi-ft5406.dtbo"
OSTREE_KERNEL:raspberrypi0-wifi = "zImage"
KERNEL_IMAGETYPE:raspberrypi0-wifi = "zImage"
KERNEL_IMAGETYPE:sota:raspberrypi0-wifi = "zImage"
KERNEL_BOOTCMD:raspberrypi0-wifi = "bootz"
```

## conf/machine/include/raspberrypi4-64.inc
```bitbake
require raspberrypi-common.inc

SOTA_DT_OVERLAYS:raspberrypi4-64 ?= "vc4-fkms-v3d-pi4.dtbo rpi-ft5406.dtbo"
VC4DTBO:raspberrypi4-64 ?= "vc4-fkms-v3d-pi4"
KERNEL_DEVICETREE:raspberrypi4-64:sota ?= " broadcom/bcm2711-rpi-4-b.dtb overlays/vc4-fkms-v3d-pi4.dtbo overlays/rpi-ft5406.dtbo"
KERNEL_BOOTCMD:raspberrypi4-64 = "booti"
PREFERRED_VERSION_linux-raspberrypi:raspberrypi4-64 = "5.15.%"
KERNEL_SERIAL:sota:raspberrypi4-64 = "${@oe.utils.conditional("ENABLE_UART", "1", "console=ttyAMA0,115200", "", d)}"
```

## scripts/lib/wic/canned-wks/torizon-sota.wks
```
# short-description: Create OTA-enabled SD card image
# long-description: Creates a partitioned SD card image with OSTree
# physical sysroot as a payload. Boot files are located in the
# first vfat partition.

part / --source otaimage --ondisk mmcblk --fstype=ext4 --align 4096
```
