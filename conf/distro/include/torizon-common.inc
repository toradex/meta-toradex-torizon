## conf/distro/include/torizon-common.inc
```bitbake
require conf/distro/include/tdx-base.inc

IMAGE_CLASSES += "image_type_torizon"
IMAGE_CLASSES_remove = "image_type_tezi image_types_fsl"

TDX_RELEASE = "0.0.0"

SDK_NAME_PREFIX = "${DISTRO}"
SDK_VERSION = "${DISTRO_VERSION}"

MAINTAINER = "Toradex TorizonCore Team <torizoncore@toradex.com>"

TCLIBCAPPEND = ""

# Torizon machine specific overrides
INHERIT += "torizon"

# No need for x11 even for native
DISTRO_FEATURES_NATIVE_remove = "x11"
DISTRO_FEATURES_NATIVESDK_remove = "x11"

PREFERRED_PROVIDER_iasl-native = "acpica-native"

MASK_META_VIRT_KERNEL_PATH = "/meta-virtualization/recipes-kernel/linux"
MASK_META_VIRT_KERNEL_PATH_intel-corei7-64 = ""

# Compatibility with toradex layers
BBMASK += " \
    /meta-toradex-bsp-common/recipes-core/systemd/systemd_%.bbappend \
    /meta-freescale/recipes-graphics/cairo \
    /meta-lmp/meta-lmp-base/recipes-sota/aktualizr/aktualizr_%.bbappend \
    ${MASK_META_VIRT_KERNEL_PATH} \
"
```

## conf/distro/include/torizon-container.inc
```bitbake
require conf/distro/include/torizon-common.inc

# TODO: review default distro features
DISTRO_FEATURES_append = " usrmerge"

# Default image formats
IMAGE_FSTYPES = "container tar"
```

## conf/distro/include/torizon.inc
```bitbake
require conf/distro/include/tdx-base.inc

MAINTAINER = "Toradex TorizonCore Team <torizoncore@toradex.com>"

TCLIBCAPPEND = ""

COPY_LIC_MANIFEST = "1"
COPY_LIC_DIRS = "1"

IMAGE_CLASSES_append = " image_type_torizon"
IMAGE_CLASSES_remove = "image_type_tezi image_types_fsl"

IMAGE_BASENAME_SUFFIX ?= ""

TDX_MAJOR = "5"

IMX_DEFAULT_BSP = "nxp"
IMX_DEFAULT_BSP_upstream = "mainline"

SDK_NAME_PREFIX = "${DISTRO}"
SDK_VERSION = "${DISTRO_VERSION}"

# TorizonCore machine specific overrides
INHERIT += "torizon toradex-sanity"

# This also disables the static packageconfig. runc needs to be dynamically
# linked for seccomp support. https://github.com/opencontainers/runc/issues/2008
PACKAGECONFIG_remove_pn-${PREFERRED_PROVIDER_virtual/runc} = "static"
PACKAGECONFIG_append_pn-${PREFERRED_PROVIDER_virtual/runc} = " seccomp"
PACKAGECONFIG_append_pn-${PREFERRED_PROVIDER_virtual/docker} = " seccomp"
PACKAGECONFIG_append_pn-systemd = " seccomp"

# Set default network configuration
PREFERRED_RPROVIDER_network-configuration = "networkmanager"

# SOTA
OSTREE_OSNAME = "torizon"
OSTREE_MULTI_DEVICETREE_SUPPORT = "1"
SOTA_CLIENT_FEATURES_append = " ubootenv"
INITRAMFS_IMAGE = "initramfs-ostree-torizon-image"
INITRAMFS_FSTYPES = "cpio.gz"
BUILD_OSTREE_TARBALL = "0"
# We do not need teziimg, ota-ext4 or wic images by default
IMAGE_FSTYPES_REMOVE ?= "ota-ext4 wic wic.gz wic.bmap"
IMAGE_FSTYPES_remove_sota = "${IMAGE_FSTYPES_REMOVE}"

# No need to install boot script, kernel image, devicetrees or firmware into the boot partition
IMAGE_BOOT_FILES = ""
IMAGE_BOOT_FILES_REMOVE_sota = "boot.scr-${MACHINE};boot.scr overlays.txt overlays/*;overlays/"
IMAGE_BOOT_FILES_REMOVE_append_apalis-imx8 = " hdmitxfw.bin dpfw.bin"

DISTRO_FEATURES_append = " virtualization stateless-system"
DISTRO_FEATURES_remove = "3g alsa irda pcmcia nfc ldconfig pulseaudio wayland x11 ptest multiarch opengl vulkan"

# No need for x11 even for native
DISTRO_FEATURES_NATIVE_remove = "x11"
DISTRO_FEATURES_NATIVESDK_remove = "x11"

# Note, enable or disable the useradd-staticids in a configured system,
# the TMPDIR/DEPLOY_DIR/SSTATE_DIR may contain incorrect uid/gid values.
# Clearing them will correct this condition.
USERADDEXTENSION = "useradd-staticids"
USERADD_UID_TABLES = "files/torizon-static-passwd"
USERADD_GID_TABLES = "files/torizon-static-group"
USERADD_ERROR_DYNAMIC = "skip"

# Compatibility with toradex layers
BBMASK += " \
    /meta-toradex-bsp-common/recipes-core/systemd/systemd_%.bbappend \
    /meta-freescale/recipes-graphics/cairo \
"

# containerd recipe from meta-lmp builds a new version that might only work
# with Docker built from the Moby project, so for now, let's force the usage
# of containerd from meta-virtualization
BBMASK += " \
    /meta-lmp/meta-lmp-base/recipes-containers/containerd \
"

# we don't want meta-lmp variables in /etc/os-release
BBMASK += " \
    /meta-lmp/meta-lmp-base/recipes-core/os-release \
"

# machines where TorizonCore is experimental
EXPERIMENTALOVERRIDES = ""
# Currently TorizonCore does not support any experimental machines, in future such machines can be added like below:
#EXPERIMENTALOVERRIDES_colibri-imx6ull = ":experimental"
DISTROOVERRIDES .= "${EXPERIMENTALOVERRIDES}"

# meta-lmp provides newer versions of wireguard recipes, but
# those don't build with our current kernel version, so let's
# use the versions provided by meta-networking
PREFERRED_VERSION_wireguard-module = "1.0.20200401"
PREFERRED_VERSION_wireguard-tools = "1.0.20200319"

# Use our variant of the aktualizr client instead of the
# default from meta-updater
PREFERRED_PROVIDER_aktualizr = "aktualizr-torizon"
PREFERRED_PROVIDER_aktualizr-native = "aktualizr-torizon-native"
PREFERRED_RPROVIDER_aktualizr = "aktualizr-torizon"
PREFERRED_RPROVIDER_aktualizr-info = "aktualizr-torizon"
PREFERRED_RPROVIDER_aktualizr-shared-prov = "aktualizr-torizon"
```

## conf/distro/tordy.conf
```bitbake
require conf/distro/include/tordy.inc
require conf/distro/sota.conf.inc

DISTRO = "tordy"
DISTRO_NAME = "Tordy Linux-microPlatform"

IMAGE_LINGUAS ?= "en-us"

# SOTA
OSTREE_OSNAME = "lmp"
OSTREE_INITRAMFS_IMAGE = "initramfs-ostree-lmp-image"
INITRAMFS_IMAGE = "${OSTREE_INITRAMFS_IMAGE}"
OSTREE_INITRAMFS_FSTYPES = "cpio.gz"
BUILD_OTA_TARBALL = "1"
## No need to install the kernel image into the boot partition
IMAGE_BOOT_FILES_remove_sota = " ${KERNEL_IMAGETYPE}"
## Runtime prov by default to allow runtime configuration
SOTA_CLIENT_PROV ?= "aktualizr-runtime-prov"

# No graphical feature as part of the base platform
DISTRO_FEATURES_remove = "wayland x11"

# General
WKS_FILE_DEPENDS_BOOTLOADERS_remove = "syslinux systemd-boot"
## We don't use the default efi sota wks file
WKS_FILE_sota_remove = "efiimage-sota.wks"

# Tezi
ROOTFS_LABEL_TEZI = "otaroot"

# Compatibility with toradex layers
BBMASK += "/meta-toradex-bsp-common/recipes-core/systemd/systemd_%.bbappend"
```

## conf/distro/torizon-container.conf
```bitbake
require conf/distro/include/torizon-container.inc

DISTRO = "torizon-container"
DISTRO_NAME = "TorizonCore Container"

# No graphical feature as part of the base platform
DISTRO_FEATURES_remove = "wayland x11"

WKS_FILE_DEPENDS_BOOTLOADERS_remove = "syslinux systemd-boot"

## We don't use the default efi sota wks file
WKS_FILE_sota_remove = "efiimage-sota.wks"

# Utils needed for configuration 
IMAGE_INSTALL_append = " u-boot-fw-utils dtconf"

PREFERRED_PROVIDER_virtual/kernel = "linux-stable"
```

## conf/distro/torizon-rt.conf
```bitbake
require conf/distro/torizon.conf

DISTRO = "torizon-rt"
DISTRO_NAME = "TorizonCore with PREEMPT_RT"
DISTRO_FLAVOUR = " (PREEMPT_RT)"

DISTROOVERRIDES .= ":preempt-rt"

IMAGE_BASENAME_SUFFIX = "-rt"
```

## conf/distro/torizon-upstream-rt.conf
```bitbake
require conf/distro/torizon-rt.conf

DISTRO = "torizon-upstream-rt"
DISTRO_NAME = "TorizonCore Upstream with PREEMPT_RT"

DISTRO_FLAVOUR = " (UPSTREAM PREEMPT_RT)"
DISTRO_FLAVOUR_experimental = " (UPSTREAM PREEMPT_RT EXPERIMENTAL)"

DISTROOVERRIDES .= ":upstream"
```

## conf/distro/torizon-upstream.conf
```bitbake
require conf/distro/torizon.conf

DISTRO = "torizon-upstream"
DISTRO_NAME = "TorizonCore Upstream"

DISTRO_FLAVOUR = " (UPSTREAM)"
DISTRO_FLAVOUR_experimental = " (UPSTREAM EXPERIMENTAL)"

DISTROOVERRIDES .= ":upstream"
```

## conf/distro/torizon.conf
```bitbake
require conf/distro/include/torizon.inc
require conf/distro/sota.conf.inc

DISTRO = "torizon"
DISTRO_NAME = "TorizonCore"

DISTRO_FLAVOUR:experimental = " (EXPERIMENTAL)"
```

## conf/layer.conf
```bitbake
# We might have a conf and classes directory, append to BBPATH
BBPATH .= ":${LAYERDIR}"

# We have a recipes directory, add to BBFILES
BBFILES += "${LAYERDIR}/recipes*/*/*.bb ${LAYERDIR}/recipes*/*/*.bbappend"

BBFILE_COLLECTIONS += "meta-common-torizon"
BBFILE_PATTERN_meta-common-torizon := "^${LAYERDIR}/"
BBFILE_PRIORITY_meta-common-torizon = "90"

LAYERDEPENDS_meta-common-torizon = "freescale-layer toradex-bsp-common-layer meta-toradex-distro sota meta-toradex-security"
LAYERSERIES_COMPAT_meta-common-torizon = "kirkstone"
```

## conf/machine/include/apalis-imx6.inc
```bitbake
TORADEX_PRODUCT_IDS = "0027 0028 0029 0035"
# The payload offsets are given in number of 512 byte blocks.
OFFSET_BOOTROM_PAYLOAD = "2"
OFFSET_SPL_PAYLOAD = "138"

KERNEL_DEVICETREE_remove = "imx6q-apalis_v1_0-eval.dtb imx6q-apalis_v1_0-ixora.dtb"

MACHINE_FIRMWARE_remove = "firmware-imx-epdc"
```

## conf/machine/include/apalis-imx8.inc
```bitbake
# to add custom configs

# let's try to not use their old and jurassic RS232
OSTREE_KERNEL_ARGS_EXTRA:append = " console=ttyLP0,115200n8 "
```

## conf/machine/include/beaglebone-yocto.inc
```bitbake
# taken from meta-freescale/conf/machine/include/utilities.inc
def make_dtb_boot_files(d):
    # Generate IMAGE_BOOT_FILES entries for device tree files listed in
    # KERNEL_DEVICETREE.
    # Use only the basename for dtb files:
    alldtbs = d.getVar('KERNEL_DEVICETREE')


    # DTBs may be built out of kernel with devicetree.bbclass
    if not alldtbs:
        return ''

    def transform(dtb):
        if not (dtb.endswith('dtb') or dtb.endswith('dtbo')):
            # eg: whatever/bcm2708-rpi-b.dtb has:
            #     DEPLOYDIR file: bcm2708-rpi-b.dtb
            #     destination: bcm2708-rpi-b.dtb
            bb.error("KERNEL_DEVICETREE entry %s is not a .dtb or .dtbo file." % (dtb) )
        return os.path.basename(dtb)

    return ' '.join([transform(dtb) for dtb in alldtbs.split() if dtb])

WKS_FILE = "beaglebone-yocto.wks"
WKS_FILE_DEPENDS:remove = "tezi-metadata virtual/dtb"
CORE_IMAGE_BASE_INSTALL:append = "resize-helper"

# beaglebone
KERNEL_BUILTIN_WIREGUARD:beaglebone-yocto = "1"
CORE_IMAGE_BASE_INSTALL:remove = "kernel-module-wireguard wireguard-tools"
PREFERRED_PROVIDER_virtual/bootloader = "u-boot"
PREFERRED_PROVIDER_virtual/bootloader:sota = "u-boot"
PREFERRED_PROVIDER_virtual/bootloader:beaglebone-yocto = "u-boot"
PREFERRED_PROVIDER_u-boot:beaglebone-yocto = "u-boot"
PREFERRED_PROVIDER_virtual/dtb = ""
WKS_FILE_DEPENDS_BOOTLOADERS:beaglebone-yocto = "virtual/bootloader"
WKS_FILE_DEPENDS:append:beaglebone-yocto = " u-boot-default-script"
PREFERRED_PROVIDER_u-boot-default-script:beaglebone-yocto = "u-boot-distro-boot"
PREFERRED_PROVIDER_u-boot-default-script:sota:beaglebone-yocto = "u-boot-distro-boot"

PREFERRED_PROVIDER_u-boot-fw-utils = "libubootenv"
PREFERRED_RPROVIDER_u-boot-fw-utils = "libubootenv"

IMAGE_FSTYPES:remove:beaglebone-yocto = "ext3 jffs2 teziimg"

# We need ota-ext4 and wic for beagle
IMAGE_FSTYPES_REMOVE = ""
IMAGE_BOOT_FILES:beaglebone-yocto = "u-boot.img MLO ${@make_dtb_boot_files(d)} boot.scr uEnv.txt "
IMAGE_BOOT_FILES:sota:beaglebone-yocto = "u-boot.img MLO ${@make_dtb_boot_files(d)} "
IMAGE_BOOT_FILES_REMOVE:sota:remove = "boot.scr-${MACHINE};boot.scr"
IMAGE_BOOT_FILES:append = " boot.scr-${MACHINE};boot.scr "

OSTREE_KERNEL:beaglebone-yocto = "zImage"
OSTREE_DEPLOY_DEVICETREE:beaglebone-yocto = "0"
KERNEL_IMAGETYPE:beaglebone-yocto = "zImage"
KERNEL_IMAGETYPE:sota:beaglebone-yocto = "zImage"

LINUX_VERSION_EXTENSION = "-torizon-${LINUX_KERNEL_TYPE}"

## same bahavior
# This boot arguments are the same from torizon.bbclass
OSTREE_KERNEL_ARGS:sota:append:beaglebone-yocto = "console=ttyS0,115200 root=LABEL=otaroot rootfstype=ext4 quiet logo.nologo vt.global_cursor_default=0 plymouth.ignore-serial-consoles splash "

UBOOT_BINARY_OTA_IGNORE:beaglebone-yocto = "1"

BBMASK += " \
    meta-common-torizon/recipes-bsp/u-boot/u-boot-toradex \
    meta-raspberrypi/recipes-bsp/u-boot/u-boot_%.bbappend \
    meta-common-torizon/recipes-bsp/u-boot/u-boot-toradex_%.bbappend \
"
```

## conf/machine/include/beagleplay.inc
```bitbake
# taken from meta-freescale/conf/machine/include/utilities.inc
def make_dtb_boot_files(d):
    # Generate IMAGE_BOOT_FILES entries for device tree files listed in
    # KERNEL_DEVICETREE.
    # Use only the basename for dtb files:
    alldtbs = d.getVar('KERNEL_DEVICETREE')


    # DTBs may be built out of kernel with devicetree.bbclass
    if not alldtbs:
        return ''

    def transform(dtb):
        if not (dtb.endswith('dtb') or dtb.endswith('dtbo')):
            # eg: whatever/bcm2708-rpi-b.dtb has:
            #     DEPLOYDIR file: bcm2708-rpi-b.dtb
            #     destination: bcm2708-rpi-b.dtb
            bb.error("KERNEL_DEVICETREE entry %s is not a .dtb or .dtbo file." % (dtb) )
        return os.path.basename(dtb)

    return ' '.join([transform(dtb) for dtb in alldtbs.split() if dtb])

WKS_FILE = "sdimage-2part.wks"
WKS_FILE_DEPENDS:remove = "tezi-metadata virtual/dtb"
CORE_IMAGE_BASE_INSTALL:append = "resize-helper"

KERNEL_BUILTIN_WIREGUARD:beagleplay = "1"
CORE_IMAGE_BASE_INSTALL:remove = "kernel-module-wireguard wireguard-tools"
PREFERRED_PROVIDER_virtual/bootloader = "u-boot-ti-staging"
PREFERRED_PROVIDER_virtual/bootloader:sota = "u-boot-ti-staging"
PREFERRED_PROVIDER_virtual/bootloader:beagleplay = "u-boot-ti-staging"
PREFERRED_PROVIDER_u-boot:beagleplay = "u-boot-ti-staging"
PREFERRED_PROVIDER_virtual/dtb = ""
WKS_FILE_DEPENDS_BOOTLOADERS:beagleplay = "virtual/bootloader"
WKS_FILE_DEPENDS:append:beagleplay = " u-boot-default-script"
PREFERRED_PROVIDER_u-boot-default-script:beagleplay = "u-boot-distro-boot"
PREFERRED_PROVIDER_u-boot-default-script:sota:beagleplay = "u-boot-distro-boot"

PREFERRED_PROVIDER_u-boot-fw-utils = "libubootenv"
PREFERRED_RPROVIDER_u-boot-fw-utils = "libubootenv"

IMAGE_FSTYPES:remove:beagleplay = "ext3 jffs2 teziimg"

# We need ota-ext4 and wic for beagle
IMAGE_FSTYPES_REMOVE = ""
IMAGE_BOOT_FILES:beagleplay = "u-boot.img tispl.bin tiboot3.bin ${@make_dtb_boot_files(d)} "
IMAGE_BOOT_FILES:sota:beaglebone-yocto = "u-boot.img tispl.bin tiboot3.bin ${@make_dtb_boot_files(d)} "
IMAGE_BOOT_FILES_REMOVE:sota:remove = "boot.scr-${MACHINE};boot.scr"
IMAGE_BOOT_FILES:append = " boot.scr-${MACHINE};boot.scr "

LINUX_VERSION_EXTENSION = "-torizon-${LINUX_KERNEL_TYPE}"

## same bahavior
# This boot arguments are the same from torizon.bbclass
OSTREE_KERNEL_ARGS:sota:append:beagleplay = "console=ttyS2,115200 root=LABEL=otaroot rootfstype=ext4 quiet logo.nologo vt.global_cursor_default=0 plymouth.ignore-serial-consoles splash "

UBOOT_BINARY_OTA_IGNORE:beagleplay = "1"
OSTREE_DEPLOY_DEVICETREE:beagleplay = "0"

PREFERRED_PROVIDER_virtual/mesa = "mesa-pvr"
PREFERRED_PROVIDER_virtual/egl = "mesa-pvr"
PREFERRED_PROVIDER_virtual/libgles1 = "mesa-pvr"
PREFERRED_PROVIDER_virtual/libgles2 = "mesa-pvr"
PREFERRED_PROVIDER_virtual/libgles3 = "mesa-pvr"
PREFERRED_PROVIDER_virtual/libgbm = "mesa-pvr"
PREFERRED_PROVIDER_virtual/libglx = "mesa-pvr"
PREFERRED_PROVIDER_virtual/libgl = "mesa-pvr"

INITRAMFS_MAXSIZE = "315400"

BBMASK += " \
    meta-common-torizon/recipes-bsp/u-boot/u-boot-toradex \
    meta-raspberrypi/recipes-bsp/u-boot/u-boot_%.bbappend \
    meta-common-torizon/recipes-bsp/u-boot/u-boot-toradex_%.bbappend \
"
```

## conf/machine/include/colibri-imx6.inc
```bitbake
TORADEX_PRODUCT_IDS = "0014 0015 0016 0017"
TORADEX_FLASH_TYPE = "emmc"
# The payload offsets are given in number of 512 byte blocks.
OFFSET_BOOTROM_PAYLOAD = "2"
OFFSET_SPL_PAYLOAD = "138"

MACHINE_FIRMWARE_remove = "firmware-imx-epdc"
```

## conf/machine/include/colibri-imx6ull.inc
```bitbake
TORADEX_PRODUCT_IDS = "0036 0040 0044 0045"
TORADEX_PRODUCT_IDS[0036] = "imx6ull-colibri-eval-v3.dtb"
TORADEX_PRODUCT_IDS[0040] = "imx6ull-colibri-wifi-eval-v3.dtb"
TORADEX_PRODUCT_IDS[0044] = "imx6ull-colibri-eval-v3.dtb"
TORADEX_PRODUCT_IDS[0045] = "imx6ull-colibri-wifi-eval-v3.dtb"
TORADEX_FLASH_TYPE = "rawnand"
```
