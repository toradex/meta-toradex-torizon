## conf/machine/include/colibri-imx7-emmc.inc
```bitbake
IMAGE_CLASSES += "image_type_tezi"
IMAGE_FSTYPES_append = " teziimg"
# The payload offsets are given in number of 512 byte blocks.
OFFSET_BOOTROM_PAYLOAD = "2"
TORADEX_PRODUCT_IDS = "0039"
TORADEX_FLASH_TYPE = "emmc"

MACHINE_FIRMWARE_remove = "firmware-imx-epdc"
```

## conf/machine/include/colibri-imx7.inc
```bitbake
# The payload offsets are given in number of 512 byte blocks.
OFFSET_BOOTROM_PAYLOAD = "2"
TORADEX_PRODUCT_IDS = "0032 0033 0039 0041"
TORADEX_PRODUCT_IDS[0032] = "imx7s-colibri-eval-v3.dtb,rawnand"
TORADEX_PRODUCT_IDS[0033] = "imx7d-colibri-eval-v3.dtb,rawnand"
TORADEX_PRODUCT_IDS[0039] = "imx7d-colibri-emmc-eval-v3.dtb,emmc"
TORADEX_PRODUCT_IDS[0041] = "imx7d-colibri-eval-v3.dtb,rawnand"
TORADEX_FLASH_TYPE = "rawnand emmc"

UBOOT_BINARY_TEZI_EMMC = "u-boot.imx-sd"
UBOOT_BINARY_TEZI_RAWNAND = "u-boot.imx-nd"

UBOOT_ENV_TEZI_EMMC = "u-boot-initial-env-sd"
UBOOT_ENV_TEZI_RAWNAND = "u-boot-initial-env-nd"

PREFERRED_PROVIDER_u-boot-default-script = "u-boot-distro-boot"

MACHINE_FIRMWARE_remove = "firmware-imx-epdc" 

PREFERRED_PROVIDER_virtual/kernel_use-mainline-bsp = "linux-toradex-mainline"
PREFERRED_PROVIDER_virtual/dtb_use-mainline-bsp = "device-tree-overlays-mainline"

KERNEL_DEVICETREE_use-mainline-bsp = "imx7d-colibri-eval-v3.dtb \
		imx7s-colibri-eval-v3.dtb imx7d-colibri-emmc-eval-v3.dtb"

# Using override to make sure to override what is set later in colibri-imx7.conf
UBOOT_MAKE_TARGET_colibri-imx7 = "u-boot.imx"
UBOOT_BINARY_colibri-imx7 = "u-boot.imx"

UBOOT_MACHINE = ""
UBOOT_CONFIG ??= "sd nd"
UBOOT_CONFIG[sd] = "colibri_imx7_emmc_defconfig,,u-boot.imx"
UBOOT_CONFIG[nd] = "colibri_imx7_defconfig,,u-boot.imx"
```

## conf/machine/include/common.inc
```bitbake
def check_machine(d):
    """Check if the MACHINE should uses meta-lmp or not"""
    if 'imx' in d.getVar('MACHINE'):
        return 'meta-lmp'
    else:
        return ''

BBMASK += " ${@check_machine(d)} "
```

## conf/machine/include/genericx86-64.inc
```bitbake
WKS_FILE_sota_genericx86-64 = "efidisk-sota.wks"
WKS_FILE_DEPENDS_remove = "tezi-metadata virtual/dtb"

OSTREE_BOOTLOADER_genericx86-64 = "grub"
OSTREE_DEPLOY_DEVICETREE_genericx86-64 = "0"
EFI_PROVIDER_genericx86-64 = "grub-efi"
SOTA_CLIENT_FEATURES_remove = "ubootenv"

IMAGE_FSTYPES_REMOVE = "hddimg teziimg"
IMAGE_FSTYPES_append = " wic.vmdk wic.vdi"

hostname_pn-base-files = "${MACHINE}"
CORE_IMAGE_BASE_INSTALL_remove = "set-hostname"

PREFERRED_PROVIDER_u-boot-default-script = ""
PREFERRED_PROVIDER_virtual/dtb = ""
```

## conf/machine/include/intel-corei7-64.inc
```bitbake
SOTA_MACHINE_intel-corei7-64 = "none"
OSTREE_KERNEL_ARGS_intel-corei7-64 = "console=ttyS0,115200 root=LABEL=otaroot rootfstype=ext4"
WKS_FILE_sota_intel-corei7-64 = "efidisk-sota.wks"

IMAGE_FSTYPES_REMOVE = "live hddimg teziimg-distro"
IMAGE_FSTYPES_append = " wic.vmdk wic.vdi"

PREFERRED_PROVIDER_virtual/kernel_intel-corei7-64 = "linux-yocto"
PREFERRED_PROVIDER_virtual/kernel_intel-corei7-64_preempt-rt = "linux-yocto-rt"
```

## conf/machine/include/nezha-allwinner-d1.inc
```bitbake
WKS_FILE:nezha-allwinner-d1 = "nezha.wks"
WIC_CREATE_EXTRA_ARGS = ""
WKS_FILE:sota:nezha-allwinner-d1 = "nezha-sota.wks"
WKS_FILE_DEPENDS:remove = "tezi-metadata virtual/dtb"
CORE_IMAGE_BASE_INSTALL:append = "resize-helper"

OSTREE_KERNEL_ARGS:sota:append:nezha-allwinner-d1 = " earlycon=sbi clk_ignore_unused initcall_debug=0 console=ttyS0,115200 loglevel=8 root=LABEL=otaroot rootfstype=ext4 root=LABEL=otaroot rootfstype=ext4 quiet logo.nologo vt.global_cursor_default=0 plymouth.ignore-serial-consoles splash "
SOTA_CLIENT_FEATURES:append:nezha-allwinner-d1 = " ubootenv"
WKS_FILE_DEPENDS_BOOTLOADERS:nezha-allwinner-d1 = "virtual/bootloader"
WKS_FILE_DEPENDS:append:nezha-allwinner-d1 = " u-boot-default-script"
PREFERRED_PROVIDER_u-boot-default-script:nezha-allwinner-d1 = "u-boot-distro-boot"
PREFERRED_PROVIDER_u-boot-default-script:sota:nezha-allwinner-d1 = "u-boot-distro-boot"

OSTREE_DEPLOY_DEVICETREE:nezha-allwinner-d1 = "0"

PREFERRED_PROVIDER_virtual/dtb = ""

KERNEL_BUILTIN_WIREGUARD:nezha-allwinner-d1 = "1"
KERNEL_IMAGETYPE:nezha-allwinner-d1 = "Image"
KERNEL_IMAGETYPE:sota:nezha-allwinner-d1 = "Image"
OSTREE_KERNEL:nezha-allwinner-d1 = "Image"
#KERNEL_DEVICETREE:nezha-allwinner-d1:sota ?= " allwinner/sun20i-d1-nezha.dtb"
UBOOT_BINARY_OTA_IGNORE:nezha-allwinner-d1 = "1"
KERNEL_BOOTCMD = "booti"

LINUX_VERSION_EXTENSION = "-torizon-${LINUX_KERNEL_TYPE}"

IMAGE_FSTYPES_REMOVE = "hddimg teziimg"

CORE_IMAGE_BASE_INSTALL:remove = "kernel-module-wireguard wireguard-tools"
IMAGE_BOOT_FILES:nezha-allwinner-d1 = "${KERNEL_IMAGETYPE} sun20i-d1-nezha.dtb boot.scr.uimg"
IMAGE_BOOT_FILES:sota:nezha-allwinner-d1 = "${KERNEL_IMAGETYPE} sun20i-d1-nezha.dtb boot.scr-${MACHINE};boot.scr.uimg"

hostname:pn-base-files = "torizon-nezha"
# FIXME: rac does not compile for riscv64, https://github.com/briansmith/ring/issues/1182
CORE_IMAGE_BASE_INSTALL:remove = "set-hostname rac"

# Use meta-lmp but maintain compatibility
BBMASK += " \
    meta-common-torizon/recipes-bsp/u-boot/u-boot-toradex \
    meta-common-torizon/recipes-bsp/u-boot/libubootenv_* \
    meta-toradex-bsp-common/recipes-bsp/u-boot/libubootenv_* \
    meta-common-torizon/recipes-bsp/u-boot/u-boot-toradex_%.bbappend \
"
```

## conf/machine/include/qemuarm64.inc
```bitbake
UBOOT_MACHINE = "qemu_arm64_defconfig"
UBOOT_ENTRYPOINT = "0x40080000"

WKS_FILE_DEPENDS_remove = "tezi-metadata virtual/dtb"
WKS_FILE_sota_qemuarm64 = "torizon-sota.wks"

OSTREE_DEPLOY_DEVICETREE_qemuarm64 = "0"

QB_MACHINE = "-machine virt"
QB_DRIVE_TYPE = "/dev/vda"
QB_DEFAULT_FSTYPE = "wic"
QB_MEM_qemuarm64 = "-m 1057"
QB_OPT_APPEND_qemuarm64 = "-show-cursor -device VGA,edid=on -device qemu-xhci -device usb-tablet -device usb-kbd -object rng-random,filename=/dev/urandom,id=rng0 -device virtio-rng-pci,rng=rng0 -no-acpi -bios ${DEPLOY_DIR_IMAGE}/u-boot.bin -d unimp -semihosting-config enable,target=native"

IMAGE_FSTYPES_REMOVE = "tar.bz2 ext4 teziimg"

hostname_pn-base-files = "${MACHINE}"
CORE_IMAGE_BASE_INSTALL_remove = "set-hostname"

PREFERRED_PROVIDER_virtual/dtb = ""
PREFERRED_RPROVIDER_network-configuration_qemuarm64 = "networkd-static-conf"

PREFERRED_PROVIDER_virtual/bootloader = "u-boot-toradex"
PREFERRED_PROVIDER_virtual/kernel_qemuarm64 = "linux-yocto"
PREFERRED_PROVIDER_virtual/kernel_qemuarm64_preempt-rt = "linux-yocto-rt"

PREFERRED_PROVIDER_u-boot-default-script_qemuarm64 = "u-boot-distro-boot"
```

## conf/machine/include/qemux86-64.inc
```bitbake
WKS_FILE:qemux86-64:sota = "efiimage-sota.wks"
WKS_FILE_DEPENDS:remove = "tezi-metadata virtual/dtb"

CORE_IMAGE_BASE_INSTALL:append = "resize-helper docker-binfmt"

OSTREE_KERNEL_ARGS:qemux86-64 = "console=ttyS0,115200 root=LABEL=otaroot rootfstype=ext4 logo.nologo vt.global_cursor_default=0 plymouth.ignore-serial-consoles splash fbcon=map:10 quiet "
OSTREE_BOOTLOADER:qemux86-64 = "grub"
OSTREE_DEPLOY_DEVICETREE:qemux86-64 = "0"
EFI_PROVIDER:qemux86-64 = "grub-efi"
SOTA_CLIENT_FEATURES:remove = "ubootenv"
UBOOT_BINARY_OTA_IGNORE:qemux86-64 = "1"

IMAGE_FSTYPES_REMOVE = "hddimg teziimg"
IMAGE_FSTYPES:append = " wic"

hostname:pn-base-files = "${MACHINE}"
CORE_IMAGE_BASE_INSTALL:remove = "set-hostname"

PREFERRED_PROVIDER_u-boot-default-script = ""
PREFERRED_PROVIDER_virtual/dtb = ""

LINUX_VERSION_EXTENSION ?= "-torizon-${LINUX_KERNEL_TYPE}"
```

## conf/machine/include/raspberrypi-common.inc
```bitbake
WKS_FILE_DEPENDS:remove = "tezi-metadata virtual/dtb"

CORE_IMAGE_BASE_INSTALL:append = "resize-helper"

# Raspberry Pi
KERNEL_BUILTIN_WIREGUARD:rpi = "1"
CORE_IMAGE_BASE_INSTALL:remove = "kernel-module-wireguard wireguard-tools"
PREFERRED_PROVIDER_virtual/bootloader = "u-boot"
PREFERRED_PROVIDER_virtual/bootloader:sota = "u-boot"
PREFERRED_PROVIDER_virtual/bootloader:rpi = "u-boot"
PREFERRED_PROVIDER_u-boot:rpi = "u-boot"
PREFERRED_PROVIDER_virtual/dtb = ""
WKS_FILE_DEPENDS_BOOTLOADERS:rpi = "virtual/bootloader"
WKS_FILE_DEPENDS:append:rpi = " u-boot-default-script"
PREFERRED_PROVIDER_u-boot-default-script:rpi = "u-boot-distro-boot"
PREFERRED_PROVIDER_u-boot-default-script:sota:rpi = "u-boot-distro-boot"

PREFERRED_PROVIDER_u-boot-fw-utils = "libubootenv"
PREFERRED_RPROVIDER_u-boot-fw-utils = "libubootenv"

IMAGE_FSTYPES:remove:rpi = "ext3 rpi-sdimg teziimg"

# We need ota-ext4 and wic for rpi
IMAGE_FSTYPES_REMOVE = ""
IMAGE_BOOT_FILES:rpi = "${BOOTFILES_DIR_NAME}/* u-boot.bin;${SDIMG_KERNELIMAGE} ${@make_dtb_boot_files(d)} boot.scr uEnv.txt "
IMAGE_BOOT_FILES:sota:rpi = "${BOOTFILES_DIR_NAME}/* u-boot.bin;${SDIMG_KERNELIMAGE} ${@make_dtb_boot_files(d)} "
IMAGE_BOOT_FILES_REMOVE:sota:remove = "boot.scr-${MACHINE};boot.scr"
IMAGE_BOOT_FILES:append = " boot.scr-${MACHINE};boot.scr "

OSTREE_KERNEL:rpi = "Image"
OSTREE_DEPLOY_DEVICETREE:rpi = "0"
KERNEL_IMAGETYPE:rpi = "Image"
KERNEL_IMAGETYPE:sota:rpi = "Image"

LINUX_VERSION_EXTENSION ?= "-torizon-${LINUX_KERNEL_TYPE}"

## Mimic meta-raspberrypi behavior
ENABLE_UART:rpi = "1"
SERIAL_CONSOLES = "115200;ttyAMA0"
KERNEL_SERIAL:sota:rpi = "${@oe.utils.conditional("ENABLE_UART", "1", "console=ttyS0,115200", "", d)}"
OSTREE_KERNEL_ARGS:sota = " 8250.nr_uarts=1 bcm2708_fb.fbwidth=656 bcm2708_fb.fbheight=614 bcm2708_fb.fbswap=1 vc_mem.mem_base=0x3ec00000 vc_mem.mem_size=0x40000000 dwc_otg.lpm_enable=0 ${KERNEL_SERIAL} usbhid.mousepoll=0 "
# This boot arguments are the same from torizon.bbclass
OSTREE_KERNEL_ARGS:sota:append:rpi = " root=LABEL=otaroot rootfstype=ext4 quiet logo.nologo vt.global_cursor_default=0 plymouth.ignore-serial-consoles splash fbcon=map:10 "

## U-Boot entrypoints for rpi
UBOOT_ENTRYPOINT:rpi = "0x00008000"
UBOOT_DTB_LOADADDRESS:rpi = "0x02600000"
UBOOT_DTBO_LOADADDRESS:rpi = "0x026d0000"
UBOOT_BINARY_OTA_IGNORE:rpi = "1"

BBMASK += " \
    meta-common-torizon/recipes-bsp/u-boot/u-boot-toradex \
    meta-raspberrypi/recipes-bsp/u-boot/u-boot_%.bbappend \
    meta-common-torizon/recipes-bsp/u-boot/u-boot-toradex_%.bbappend \
"
```
